
#include <Adafruit_GFX.h>
#include <Adafruit_SSD1306.h>
#include <Servo.h>

Servo right_arm;
Servo left_arm;
Servo gripper;

Adafruit_SSD1306 display(128, 64);

const unsigned char epd_bitmap_crevo [] PROGMEM = {
	0x00, 0x00, 0x00, 0x00, 0x00, 0x00, 0x00, 0x00, 0x00, 0x00, 0x00, 0x00, 0x00, 0x00, 0x00, 0x00, 
	0x00, 0x00, 0x00, 0x00, 0x00, 0x00, 0x00, 0x00, 0x00, 0x00, 0x00, 0x00, 0x00, 0x00, 0x00, 0x00, 
	0x00, 0x00, 0x00, 0x00, 0x00, 0x00, 0x00, 0x00, 0x00, 0x00, 0x00, 0x00, 0x00, 0x00, 0x00, 0x00, 
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	0x00, 0x00, 0x00, 0x00, 0x00, 0x00, 0x00, 0x00, 0x00, 0x00, 0x00, 0x00, 0x00, 0x00, 0x00, 0x00
};

// Array of all bitmaps for convenience. (Total bytes used to store images in PROGMEM = 1040)
const int epd_bitmap_allArray_LEN = 1;
const unsigned char* epd_bitmap_allArray[1] = {
	epd_bitmap_crevo
};
//button
int button1 = A15;
int button2 = A14;
int button3 = A13;

//servo
int mission = 0;
int r_servo=90;
int l_servo=90;
int grip=10;

//
 #define B_IN1 31
 #define B_IN2 29
 #define B_IN3 27
 #define B_IN4 25
 #define B_ENA 7
 #define B_ENB 6

 #define A_IN1 30
 #define A_IN2 28
 #define A_IN3 26
 #define A_IN4 24
 #define A_ENA 12
 #define A_ENB 13

 //sensor depan
 #define S1 49
 #define S2 47
 #define S3 45
 #define S4 43
 #define S5 41
 int IR1,IR2,IR3,IR4,IR5;


void setup() {
  // put your setup code here, to run once:
Serial.begin(9600);
pinMode(button1,INPUT);
pinMode(button2,INPUT);
pinMode(button3,INPUT);
pinMode(S1,INPUT);
pinMode(S2,INPUT);
pinMode(S3,INPUT);
pinMode(S4,INPUT);
pinMode(S5,INPUT);
pinMode(B_IN1,OUTPUT);
pinMode(B_IN2,OUTPUT);
pinMode(B_IN3,OUTPUT);
pinMode(B_IN4,OUTPUT);
pinMode(A_IN1,OUTPUT);
pinMode(A_IN2,OUTPUT);
pinMode(A_IN3,OUTPUT);
pinMode(A_IN4,OUTPUT);
pinMode(A_ENA,OUTPUT);
pinMode(B_ENA,OUTPUT);
pinMode(A_ENB,OUTPUT);
pinMode(B_ENB,OUTPUT);
right_arm.attach(9);
left_arm.attach(8);
gripper.attach(11);

  display.begin( SSD1306_SWITCHCAPVCC, 0x3C);
  display.clearDisplay(); //set display oled menjadi kosong
  display.drawBitmap(0, 0, epd_bitmap_crevo, 128, 64, WHITE); //menampilkan gambar sesuai hasil convert image, myBitmap disesuaikan dengan nama variabel yang digunakan
	display.setTextColor(1); //setting warna text yang akan ditampilkan
  display.setTextSize(1); //setting ukuran text yang akan ditampilkan
  display.display();
  delay(2000);
  digitalWrite(A_ENA,HIGH);
  digitalWrite(A_ENB,HIGH);
  digitalWrite(B_ENA,HIGH);
  digitalWrite(B_ENB,HIGH);
  right_arm.write(r_servo);
  left_arm.write(l_servo);
  gripper.write(grip);
}

void loop() {
  // put your main code here, to run repeatedly:
 /*
gripper_depan();
delay(1000);
gripper_tutup();
delay(1000);
gripper_tengah();
delay(1000);
gripper_belakang();
delay(1000);
gripper_buka();
delay(1000);
gripper_tengah();
delay(1000);
*/
baca_sensor();
//maju();
if(digitalRead(button1)==LOW){
  //r_servo++;
  //l_servo--;
  mission++;
  delay(100);
}else if(digitalRead(button2)==LOW){
  //r_servo--;
  //l_servo++;
  mission--;
  delay(100);
}
  right_arm.write(r_servo);
  left_arm.write(l_servo);
  display.clearDisplay(); 
	display.setTextSize(3);
	display.setCursor(10, 10); 
  display.print(mission); 
  display.display(); 

if(mission>18){
  mission = 1;
}else if(mission<1){
  mission = 18;
}


switch (mission){

  case 1 :
  display.clearDisplay(); 
	display.setTextSize(3);
	display.setCursor(10, 10); 
  display.print("1"); 
  display.display(); 
  koreksi();
  break;

  case 2 :
  display.clearDisplay(); 
	display.setTextSize(3);
	display.setCursor(10, 10); 
  display.print("2"); 
  display.display(); 
  mundur();
  break;

  case 3 :
  display.clearDisplay(); 
	display.setTextSize(3);
	display.setCursor(10, 10); 
  display.print("3"); 
  display.display(); 
  geser_kiri();
  break;

  case 4 :
  display.clearDisplay(); 
	display.setTextSize(3);
	display.setCursor(10, 10); 
  display.print("4"); 
  display.display(); 
  geser_kanan();
  break;

    case 18 :
  display.clearDisplay(); 
	display.setTextSize(3);
	display.setCursor(10, 10); 
  display.print("1"); 
  display.display(); 
  mati();
  break;
}



}
